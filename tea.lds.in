#include <config.h>

#ifdef i386
#undef i386
#endif

OUTPUT_FORMAT("elf32-i386", "elf32-i386", "elf32-i386")
OUTPUT_ARCH(i386)
ENTRY(start16)

SECTIONS
{
	. = TEA_ENTRY_ADDR;
	.trampoline : {
		*(.start16);
	}

	__text_start = .;
	.text  : {
		*(.text*);
		*(.isr_handle);
	}

	. = ALIGN(8);
	.initcall0 : {
		_initcall0_start = ADDR(.initcall0);
		KEEP(*(.initcall0*));
		_initcall0_end = .;
	}

	. = ALIGN(8);
	.initcall1 : {
		_initcall1_start = ADDR(.initcall1);
		KEEP(*(.initcall1*));
		_initcall1_end = .;
	}

	. = ALIGN(8);
	.initcall2 : {
		_initcall2_start = ADDR(.initcall2);
		KEEP(*(.initcall2*));
		_initcall2_end = .;
	}

	. = ALIGN(4);
	.data : { *(.data*); }
	.bss : { *(.bss*) }

	. = ALIGN(4096);
	_stack_end = .;
	. += TEA_STACK_SIZE;
	_stack_start = .;

	. = ALIGN(4096);
	. = MEM_LOG_ADDR;
	mem_log = .;
	. += MEM_LOG_SIZE;
	mem_log_end = .;

	. = ALIGN(4);
	. = SHARE_MEM_ADDR;
	share_mem = .;
	. += SHARE_MEM_SIZE;
	share_mem_end = .;

	/DISCARD/ : {
		*(.comment)
		*(.eh_frame*)
	}
}

ASSERT((_stack_start < MEM_LOG_ADDR) && (share_mem_end < TEA_SIZE), "Tea memory layout overflow!!!");
